## iwlwifi-stack-dev/drivers/net/wireless/intel/iwlwifi/Kconfig.noupstream
```kconfig
config IWLXVT
	tristate "Enable XVT op_mode"
	depends on IWLWIFI
	select IWLWIFI_DEVICE_TESTMODE
	select IWLWIFI_SUPPORT_DEBUG_OVERRIDES
	select IWLWIFI_OPMODE_MODULAR
	help
	  This option enables the xVT operation mode. xVT mode supports
	  special debug and testing operations that are not supported in
	  the standard operation modes, and is used for verification
	  purposes.
	  xVT mode does not support the standard WiFi operations, and
	  does not communicate with the user mode through the nl80211.

	  Enabling this options allows to fully control the HW using
	  an external tool in user space.

	  Say Y if you have the user space application and want
	  to execute debug and testing flows on the HW.

config IWLPROD
	tristate "Enable Production op_mode"
	depends on IWLWIFI
	select IWLWIFI_SUPPORT_DEBUG_OVERRIDES
	select IWLWIFI_OPMODE_MODULAR
	help
	  This option enables the Production operation mode. This mode supports
	  loading special production uCode that is used in factory production
	  line. Use this mode for testing the production uCode.

config IWLMVM_AX_SOFTAP_TESTMODE
	bool "enable 11ax softap testmode debugfs configuration files"
	depends on IWLMVM
	depends on MAC80211_DEBUGFS
	default y
	help
	  Enable 11ax softap testmode debugfs entries that can be used to
	  enable/disable test modes for trigger frame sending to an 11ax
	  testmode client.

config IWLWIFI_DEVICE_TESTMODE
	bool "enable generic netlink testmode support"
	depends on IWLWIFI
	default y if IWLMVM
	select IWLWIFI_SUPPORT_DEBUG_OVERRIDES

config IWLWIFI_SUPPORT_DEBUG_OVERRIDES
	depends on IWLWIFI
	bool "enable default value override (for debugging)"

config IWLWIFI_FW_MISBEHAVE_NMI_DEFAULT
	depends on IWLWIFI_SUPPORT_DEBUG_OVERRIDES
	int "NMI the firmware on unexpected behaviour"
	range 0 1
	default 1

config IWLWIFI_FORCE_OFDM_RATE
	bool "force transmit to OFDM low rate"
	depends on IWLMVM
	help
	  This option force the FW to transmit OFDM rate.

	  If unsure say N, Say Y if you have this code and want to transmit OFDM low rate.

config IWL_VENDOR_CMDS
	bool "enable vendor commands"
	depends on IWLMVM || IWLMLD
	default y
	help
	  This option enables support for vendor commands, including some
	  that don't have their own Kconfig option. Other Kconfig options
	  depend on this one as well.

	  This option mostly exists for non-upstream tagging, so best
	  leave it set to Y.

config IWLWIFI_DISALLOW_OLDER_FW
	bool "disallow fallback to older firmware images"
	depends on IWLWIFI
	help
	  This Kconfig option allows disabling fallback to older firmware images
	  to ensure tight coupling between driver and firmware releases. When
	  enabled, the dbg-cfg framework can still override this setting.

config IWLWIFI_DHC_PRIVATE
	bool "enable *private* DHC commands"
	help
	  This option enables the use of private debug host commands.  It's used
	  for internal debugging purposes and not intended for upstream.

config IWLWIFI_ATLAS_PLATFORM_WORKAROUND
	bool "enable Atlas platform workaround code"
	help
	  Say Y here to enable Atlas platform detection at runtime,
	  to enable a specific workaround if detected.

config IWLWIFI_FPGA
	bool "enable FPGA workaround code"
	help
	  The code that is related to fpga is not intended to ever go upstream.

config IWLWIFI_SLE
	bool "enable SLE workaround code"
	help
	  The code that is related to sle is not intended to ever go upstream.

config IWLWIFI_SIMULATION
	def_bool y
	depends on UML

config IWLWIFI_PLATFORM_MOCKUPS
	bool "enable ACPI testing mock-ups"
	default y
	# this means kernel is >= 4.13, i.e. no 4.13 backports required
	# we need this because we override acpi_evaluate_dsm() which has
	# different API in 3.14-4.13
	depends on !KERNEL_4_13
	help
	  If enabled, the ACPI functions are substituted by mock-ups
	  that can be controlled to return what we want in order to
	  test ACPI-based features.

config IWLWIFI_DONT_DUMP_FIFOS
	bool "do not dump FIFO contents"
	help
	  If enabled, instruct the driver to not dump FIFO regions as
	  they may contain PII.

config IWLWIFI_IPU_SECURITY_FIX
	bool "enable IPU security fixes"
	default n
	help
	  If enabled, IPU fixes will be included in compilation for
	  testing security code changes.

config IWLWIFI_PRE_IPU_SECURITY_FIX
	bool "enable pre IPU security fixes"
	default n
	depends on IWLWIFI_IPU_SECURITY_FIX
	help
	  If enabled, pre IPU fixes will be included in compilation for
	  testing security code changes.

config IWLWIFI_NJ_SUPPORT
	bool "enable support for *nJ devices"
	default y
	help
	  If enabled, add support for *nJ test devices.

config IWLWIFI_PRE_SILICON_SUPPORT
	bool "Support for pre-silicon timeout/delay factors"
	depends on IWLWIFI
	help
	  Enable dynamic timeout and delay factors for pre-silicon validation
	  platforms (ESL, SLE, FPGA). This feature detects the platform type at
	  runtime and automatically adjusts timeout and delay values to
	  accommodate slower pre-silicon hardware.
```
